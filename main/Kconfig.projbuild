## main/Kconfig.projbuild
```kconfig
menu "Project configuration"
    config WIFI_AP_MODE_ENABLED
        bool "Access point mode"
        default y
        help
            Run in access point mode. Disable to run in station mode.

    config WIFI_SSID
        string "WiFi SSID"
        default "NOKIA-3K9N4H1"
        help
            SSID (network name) for the example to connect to.
        
    config WIFI_PASSWORD
        string "WiFi Password"
        default "mypassword"
        help
            WiFi password (WPA or WPA2) for the example to use.
        
    config WIFI_CHANNEL
        int "WiFi Channel"
        range 1 13
        default 1
        depends on WIFI_AP_MODE_ENABLED 
        help
            WiFi channel (network channel) for the example to use.
    
    config MAX_STA_CONN
        int "Maximal STA connections"
        default 4
        depends on WIFI_AP_MODE_ENABLED 
        help
            Max number of the STA connects to AP.

    config AUDIO_IN_GPIO
        int "Audio IN GPIO Pin"
        range 1 36
        default 35
        help
            Audio IN GPIO Pin to use.

    config AUDIO_OUT_GPIO
        int "Audio OUT GPIO Pin"
        range 1 30
        default 25
        help
            Audio OUT GPIO Pin to use.

    config AUDIO_OUT_VOLUME
        int "Audio OUT volume"
        range 0 100
        default 4
        help
            Audio OUT volume.

    config PTT_GPIO
        int "PTT GPIO Pin"
        range 1 30
        default 26
        help
            PTT GPIO Pin to use.

    config PTT_ON_DELAY
        int "PTT on delay in ms"
        range 0 2000
        default 500
        help
            PTT on delay in ms.

    config PTT_OFF_DELAY
        int "PTT off delay in ms"
        range 0 2000
        default 500
        help
            PTT off delay in ms.

    config STATUS_LED_GPIO
        int "Status LED GPIO Pin"
        range 1 33
        default 23
        help
            Audio OUT GPIO Pin to use.

    config STATUS_LED_GPIO_MAX_BRIGHTNESS 
        int "Status LED max brightness"
        range 0 100
        default 50
        help
            Status LED max brightness.

    config TOUCH_BUTTON_1_NUMBER
        int "Touch button 1 number"
        default 9
        help
            Touch button 1 number.

    config UART_RX_GPIO
        int "UART RX GPIO Pin"
        range 1 30
        default 17
        help
            UART RX GPIO Pin.

    config UART_TX_GPIO
        int "UART TX GPIO Pin"
        range 1 30
        default 16
        help
            UART TX GPIO Pin.

    config SD_CARD_ENABLE_GPIO
        int "SD CARD ENABLE GPIO Pin"
        range 1 30
        default 5
        help
            SD CARD ENABLE GPIO Pin.

    config UART_BAUD_RATE
        int "UART baud rate"
        range 1200 230400
        default 115200
        help
            UART baud rate.

    config AUDIO_IN_SQUELCH
        int "Squelch value for audio input"
        range 0 100
        default 5
        help
            Squelch value for audio input

    config BEACON_MODE
        int "Beacon mode"
        default 0
        help
            Beacon mode.

    config BEACON_TEXT
        string "Beacon text"
        default "Default text"
        help
            Beacon text.

    config BEACON_DELAY_SECONDS
        int "Beacon repeat delay in seconds"
        range 5 65535
        default 25
        help
            Beacon repeat delay in seconds

    config MORSE_CODE_BEACON_TONE_FREQ
        int "Morse code beacon tone frequency"
        range 500 4000
        default 800
        help
            Morse code beacon tone frequency

    config MORSE_CODE_BEACON_BAUD
        int "Morse code beacon baud"
        range 1 200
        default 5
        help
            Morse code beacon baud

    config AFSK_BEACON_BAUD
        int "AFSK beacon baud"
        range 50 1200
        default 1200
        help
            AFSK beacon baud.

    config AFSK_ZERO_FREQ
        int "AFSK zero frequency"
        range 300 4000
        default 2200
        help
            AFSK zero frequency.

    config AFSK_ONE_FREQ
        int "AFSK one frequency"
        range 300 4000
        default 1200
        help
            AFSK one frequency.

    config WAV_BEACON_FILEPATH
        string "WAV beacon filepath"
        default "/storage/sample.wav"
        help
            Filepath of the .wav file.
endmenu
```
